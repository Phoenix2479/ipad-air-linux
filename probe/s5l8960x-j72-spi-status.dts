// SPDX-License-Identifier: GPL-2.0
#include "s5l8960x-j72.dts"

&{/soc} {
	spi-status@20a088000 {
		compatible = "apple,j72-spi-status";
		reg = <0x2 0x0a088000 0x0 0x4000>;
		power-domains = <&ps_spi2>;
		status = "okay";
	};
};
